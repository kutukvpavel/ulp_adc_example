
/* ULP variable definitions for the linker.
 * This file is generated automatically by esp32ulp_mapgen.py utility.
 */
PROVIDE ( ulp_irq_vector = 0x50000010 );
PROVIDE ( ulp_main = 0x5000002e );
PROVIDE ( ulp_reset_vector = 0x50000000 );
PROVIDE ( ulp_SENS = 0x5000c800 );
PROVIDE ( ulp___stack_top = 0x50000800 );
PROVIDE ( ulp_ulp_riscv_adc_read_channel = 0x50000070 );
PROVIDE ( ulp_ulp_riscv_halt = 0x5000013c );
PROVIDE ( ulp_ulp_riscv_rescue_from_monitor = 0x5000011c );
PROVIDE ( ulp_ulp_riscv_wakeup_main_processor = 0x50000130 );
PROVIDE ( ulp_wakeup_result = 0x50000168 );
